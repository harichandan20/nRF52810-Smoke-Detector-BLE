## Task-08-Both-TCP-Server-and-HTML-page-notifications/ESP32GATEWAY/sdkconfig.defaults
```kconfig
CONFIG_BT_ENABLED=y
CONFIG_BT_NIMBLE_ENABLED=y
CONFIG_BT_NIMBLE_ROLE_CENTRAL=y
CONFIG_BT_NIMBLE_ROLE_OBSERVER=y
CONFIG_BT_NIMBLE_MAX_CONNECTIONS=3
CONFIG_ESP_MAIN_TASK_STACK_SIZE=4096
```
